// SPDX-License-Identifier: BSD-3-Clause
/*
 * TB323FU ("baldur") compute DSP. The reserved regions in kaanapali.dtsi
 * (cdsp 0x1900000 at 0x9b500000, dtb 0x80000 at 0x9ce00000) match the vendor
 * tree.
 */

&remoteproc_cdsp {
	firmware-name = "qcom/kaanapali/lenovo/baldur/cdsp.mbn",
			"qcom/kaanapali/lenovo/baldur/cdsp_dtb.mbn";

	status = "okay";
};
