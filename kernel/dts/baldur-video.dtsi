// SPDX-License-Identifier: BSD-3-Clause
/*
 * Lenovo Legion Tab Y700 5th Gen (TB323FU, "baldur"): iris video codec (VPU 4.0)
 * with the OEM-signed firmware from the Android vendor partition
 * (vendor/firmware/vpu40_2v.mbn), kept with the ADSP/CDSP images.
 */

&iris {
	firmware-name = "qcom/kaanapali/lenovo/baldur/vpu40_2v.mbn";
	status = "okay";
};
