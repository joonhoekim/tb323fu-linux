// SPDX-License-Identifier: BSD-3-Clause
/*
 * TB323FU ("baldur") RGB ring under the rear camera -- the "gaming
 * lighting" (y705-mainline-plan.md 9-62): an Awinic AW22127 LED matrix
 * driver at i2c5 0x6a (vendor "awinic,aw22xxx_led"), held in reset by
 * PMH0110_D gpio11 (vendor pinctrl: output high = running, power-source 1).
 * The chip's MCU program is in its own flash; leds-aw22127 (0034) sends it
 * a one-colour command. Vendor effect files play with tools/agent/aw22-play.sh.
 */

&i2c5 {
	led-controller@6a {
		compatible = "awinic,aw22127";
		reg = <0x6a>;

		reset-gpios = <&pmh0110_d_e0_gpios 11 GPIO_ACTIVE_LOW>;
		pinctrl-0 = <&ledring_reset_default>;
		pinctrl-names = "default";
	};
};

&pmh0110_d_e0_gpios {
	ledring_reset_default: ledring-reset-default-state {
		pins = "gpio11";
		function = "normal";
		power-source = <1>;
		bias-disable;
	};
};
